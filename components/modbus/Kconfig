## components/modbus/Kconfig
```kconfig
menu "Modbus-module Configuration"

menuconfig MODBUS_MANAGER_ENABLE
    bool "Modbus Manager"
    default y

endmenu
```

## components/network/Kconfig
```kconfig
menu "Internet Configuration"


config INTERNET_TARGET_URL
    string "Remote Internet target URL"
    default "https://blockboxchain-api.beesoft.it/saveData"
    help
      URL where all internet data should be sent.
      Example: http://myserver.com/api/data

choice INTERNET_NETWORK_TYPE
    prompt "Preferred network type"
    default INTERNET_NETWORK_AUTO

config INTERNET_NETWORK_AUTO
    bool "AUTO (WiFi first, then LTE fallback)"

config INTERNET_NETWORK_WIFI_ONLY
    bool "WiFi only"

config INTERNET_NETWORK_LTE_ONLY
    bool "LTE only"

endchoice

config WIFI_CONNECT_TIMEOUT_MS
    int "WiFi connect timeout per attempt (ms)"
    default 8000
    range 1000 60000

config WIFI_CONNECT_RETRIES
    int "WiFi connect retries"
    default 3
    range 1 20

config WIFI_CONNECT_RETRY_DELAY_MS
    int "WiFi delay between retries (ms)"
    default 500
    range 0 60000

config WIFI_SSID
    string "WiFi SSID"
    default ""

config WIFI_PASSWORD
    string "WiFi password"
    depends on WIFI_AUTH_WPA2_PSK || WIFI_AUTH_WPA2_ENTERPRISE
    default ""

config WIFI_USERNAME
    string "WiFi enterprise username"
    depends on WIFI_AUTH_WPA2_ENTERPRISE
    default ""

config WIFI_EAP_IDENTITY
    string "WiFi enterprise identity (optional)"
    depends on WIFI_AUTH_WPA2_ENTERPRISE
    default ""

choice WIFI_AUTH_MODE
    prompt "WiFi authentication mode"
    default WIFI_AUTH_WPA2_PSK

config WIFI_AUTH_OPEN
    bool "Open"

config WIFI_AUTH_WPA2_PSK
    bool "WPA2-PSK"

config WIFI_AUTH_WPA2_ENTERPRISE
    bool "WPA2-Enterprise"

endchoice

endmenu
```

## components/services/Kconfig
```kconfig
menu "Services Configuration"

menuconfig STORAGE_SERVICE_ENABLE
    bool "Storage Service"
    default y
    help
      Enable storage module startup from services manager.

menuconfig MODBUS_SERVICE_ENABLE
    bool "Modbus Service"
    default y
    help
      Enable modbus module startup from services manager.

menuconfig TIME_SERVICE_ENABLE
    bool "Time Service"
    default y

if TIME_SERVICE_ENABLE

config TIME_SERVICE_TZ
    string "Time zone (TZ string)"
    default "CET-1CEST,M3.5.0/2,M10.5.0/3"
    help
      POSIX TZ string used to convert local time.

config TIME_SERVICE_SYNC_TIMEOUT_MS
    int "Time sync timeout (ms)"
    default 15000
    range 1000 120000

config TIME_SERVICE_NTP_SERVER_1
    string "Primary NTP server"
    default "time.google.com"

config TIME_SERVICE_NTP_SERVER_2
    string "Secondary NTP server"
    default "pool.ntp.org"
    depends on LWIP_SNTP_MAX_SERVERS > 1

endif

endmenu
```

## components/storage/Kconfig
```kconfig
menu "Storage Configuration"

config MEMORY_LITTLEFS_MOUNT_POINT
    string "LittleFS mount point"
    default "/lfs"
    help
      Base mount point used by the storage queue.

config MEMORY_LITTLEFS_PARTITION_LABEL
    string "LittleFS partition label"
    default "storage"
    help
      Partition label used by esp_vfs_littlefs_register().
      Leave empty to mount the first LittleFS partition found.

config MEMORY_SAMPLE_QUEUE_BYTES
    int "Queue capacity in bytes"
    default 262144
    range 4096 4194304
    help
      Maximum number of bytes reserved to store Modbus samples.

config MEMORY_MAX_REGISTERS
    int "Maximum registers per Modbus sample"
    default 1084
    range 1 4096
    help
      Upper bound for one sample payload, used as safety guard.

choice MEMORY_OVERFLOW_POLICY
    prompt "Overflow policy"
    default MEMORY_OVERFLOW_OVERWRITE_OLDEST
    help
      Behavior when the queue is full.

config MEMORY_OVERFLOW_OVERWRITE_OLDEST
    bool "Overwrite oldest sample (circular queue)"

config MEMORY_OVERFLOW_REJECT_NEWEST
    bool "Reject newest sample when full"

endchoice

endmenu
```

## sdkconfig.defaults
```kconfig
# Shared ESP-IDF defaults for this project.
# Safe to commit: sensitive fields are intentionally blank.
#
# After cloning, set local values with:
#   idf.py menuconfig

CONFIG_IDF_TARGET="esp32s3"

#
# Serial flasher config
#
# CONFIG_ESPTOOLPY_NO_STUB is not set
# CONFIG_ESPTOOLPY_OCT_FLASH is not set
CONFIG_ESPTOOLPY_FLASH_MODE_AUTO_DETECT=y
# CONFIG_ESPTOOLPY_FLASHMODE_QIO is not set
# CONFIG_ESPTOOLPY_FLASHMODE_QOUT is not set
CONFIG_ESPTOOLPY_FLASHMODE_DIO=y
# CONFIG_ESPTOOLPY_FLASHMODE_DOUT is not set
CONFIG_ESPTOOLPY_FLASH_SAMPLE_MODE_STR=y
CONFIG_ESPTOOLPY_FLASHMODE="dio"
# CONFIG_ESPTOOLPY_FLASHFREQ_120M is not set
CONFIG_ESPTOOLPY_FLASHFREQ_80M=y
# CONFIG_ESPTOOLPY_FLASHFREQ_40M is not set
# CONFIG_ESPTOOLPY_FLASHFREQ_20M is not set
CONFIG_ESPTOOLPY_FLASHFREQ="80m"
# CONFIG_ESPTOOLPY_FLASHSIZE_1MB is not set
# CONFIG_ESPTOOLPY_FLASHSIZE_2MB is not set
# CONFIG_ESPTOOLPY_FLASHSIZE_4MB is not set
CONFIG_ESPTOOLPY_FLASHSIZE_8MB=y
# CONFIG_ESPTOOLPY_FLASHSIZE_16MB is not set
# CONFIG_ESPTOOLPY_FLASHSIZE_32MB is not set
# CONFIG_ESPTOOLPY_FLASHSIZE_64MB is not set
# CONFIG_ESPTOOLPY_FLASHSIZE_128MB is not set
CONFIG_ESPTOOLPY_FLASHSIZE="8MB"
CONFIG_ESPTOOLPY_BEFORE_RESET=y
# CONFIG_ESPTOOLPY_BEFORE_NORESET is not set
CONFIG_ESPTOOLPY_BEFORE="default_reset"
CONFIG_ESPTOOLPY_AFTER_RESET=y
# CONFIG_ESPTOOLPY_AFTER_NORESET is not set
CONFIG_ESPTOOLPY_AFTER="hard_reset"
CONFIG_ESPTOOLPY_MONITOR_BAUD=115200

#
# Partition Table
#
CONFIG_PARTITION_TABLE_CUSTOM=y
CONFIG_PARTITION_TABLE_CUSTOM_FILENAME="partitions.csv"
CONFIG_PARTITION_TABLE_FILENAME="partitions.csv"
CONFIG_PARTITION_TABLE_OFFSET=0x8000
CONFIG_PARTITION_TABLE_MD5=y

#
# Modbus-module Configuration
#
CONFIG_MODBUS_MANAGER_ENABLE=y

#
# Internet Configuration
#
CONFIG_INTERNET_TARGET_URL=""
# CONFIG_INTERNET_NETWORK_AUTO is not set
CONFIG_INTERNET_NETWORK_WIFI_ONLY=y
# CONFIG_INTERNET_NETWORK_LTE_ONLY is not set
CONFIG_WIFI_CONNECT_TIMEOUT_MS=5000
CONFIG_WIFI_CONNECT_RETRIES=3
CONFIG_WIFI_CONNECT_RETRY_DELAY_MS=500
CONFIG_WIFI_SSID=""
CONFIG_WIFI_PASSWORD=""
# CONFIG_WIFI_AUTH_OPEN is not set
CONFIG_WIFI_AUTH_WPA2_PSK=y
# CONFIG_WIFI_AUTH_WPA2_ENTERPRISE is not set

#
# Services Configuration
#
CONFIG_INTERNET_SERVICE_ENABLE=y
CONFIG_STORAGE_SERVICE_ENABLE=y
CONFIG_MODBUS_SERVICE_ENABLE=y
CONFIG_TIME_SERVICE_ENABLE=y
CONFIG_TIME_SERVICE_TZ="CET-1CEST,M3.5.0/2,M10.5.0/3"
CONFIG_TIME_SERVICE_SYNC_TIMEOUT_MS=15000
CONFIG_TIME_SERVICE_NTP_SERVER_1="time.google.com"

#
# Storage Configuration
#
CONFIG_MEMORY_LITTLEFS_MOUNT_POINT="/lfs"
CONFIG_MEMORY_LITTLEFS_PARTITION_LABEL="storage"
CONFIG_MEMORY_SAMPLE_QUEUE_BYTES=262144
CONFIG_MEMORY_MAX_REGISTERS=1084
CONFIG_MEMORY_OVERFLOW_OVERWRITE_OLDEST=y
# CONFIG_MEMORY_OVERFLOW_REJECT_NEWEST is not set
```
